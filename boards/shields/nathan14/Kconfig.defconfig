## boards/shields/nathan14/Kconfig.defconfig
```kconfig
if SHIELD_NATHAN14

config ZMK_KEYBOARD_NAME
    default "nathan14"

CONFIG_ZMK_DISPLAY=y

ZMK_STUDIO=y
    
CONFIG_ZMK_DISPLAY_BLANK_ON_IDLE=y

CONFIG_ZMK_STUDIO_LOCKING=n

CONFIG_ZMK_EXT_POWER=y

if LVGL

config LV_Z_VDB_SIZE
    default 64

config LV_DPI_DEF
    default 148

config LV_Z_BITS_PER_PIXEL
    default 1

choice LV_COLOR_DEPTH
    default LV_COLOR_DEPTH_1
endchoice

endif # LVGL

endif # SHIELD_NATHAN14
```
